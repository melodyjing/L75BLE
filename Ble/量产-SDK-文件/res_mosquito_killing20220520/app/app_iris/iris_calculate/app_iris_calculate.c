/******************************************************************************
	Confidential and copyright 2014-2021 Radiawave Ltd.
	
	Author:Liujian
	
	Cobra Drivers

	File Name	:	app_iris_calculate.c
	Version		:	0.1
	Created	By	:	LiuJian
	Date		:	2019/12/17

	Description :   
	  Test the csem rf module to transter data 				

	Changed Log	:

		Liujian  2019/12/17			- Creation


*****************************************************************************/
#include "app_iris_calculate.h"
#include "cobra_ceva_baseband.h"
#include "rdw_mcu.h"
#include "rwip_config.h"  
#include "ke_event.h"
#include "cobra_timer.h"
#include <string.h>
#include "rdw_gpio.h"
#include "cobra_pinmux.h"
#define 	CSEM_RF_INIT_TBL_1MBPS_SIZE        0xFC

#if(BLE_DIANBIAO_CALCUALTE_ENABLE  && DIANBIAO_PROTOCOL_ZHENGTAI_ENABLE)
unsigned int app_iris_set_frequency(unsigned short frequency);
void app_iris_set_access_address(unsigned int address);
void app_iris_set_whitelist_value(unsigned short frequency);
//#define RF_COM_CHANNEL   2361
//#define RF_SYN_WORD      0x12345678
static unsigned short old_frequency = 0;
static csem_tx_callback_t p_csem_tx_callback;
static csem_rx_callback_t p_csem_rx_callback;

static const unsigned char BitReverseTable256[] = 
{
  0x00, 0x80, 0x40, 0xC0, 0x20, 0xA0, 0x60, 0xE0, 0x10, 0x90, 0x50, 0xD0, 0x30, 0xB0, 0x70, 0xF0, 
  0x08, 0x88, 0x48, 0xC8, 0x28, 0xA8, 0x68, 0xE8, 0x18, 0x98, 0x58, 0xD8, 0x38, 0xB8, 0x78, 0xF8, 
  0x04, 0x84, 0x44, 0xC4, 0x24, 0xA4, 0x64, 0xE4, 0x14, 0x94, 0x54, 0xD4, 0x34, 0xB4, 0x74, 0xF4, 
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  0x0F, 0x8F, 0x4F, 0xCF, 0x2F, 0xAF, 0x6F, 0xEF, 0x1F, 0x9F, 0x5F, 0xDF, 0x3F, 0xBF, 0x7F, 0xFF
};

///* csem mode  static settings - v0x20- 1Mbps table */ 
//static  const uint8_t CSEM_RF_TBL_1MBPS[CSEM_RF_INIT_TBL_1MBPS_SIZE] =
//{
//    0x22, 0x00, 0x00, 0x80,   0x00, 0x22, 0x0b, 0x14,    0x10, 0x20, 0x00, 0x00,   0x00, 0x03, 0x00, 0xff, // 0x0*
//    0xff, 0x0f, 0x00, 0x00,   0x80, 0x23, 0x82, 0x00,    0x30, 0xcb, 0x15, 0x82,   0x00, 0x01, 0x01, 0x00, // 0x1*
//    0x72, 0x1c, 0x87, 0x82,   0xff, 0x00, 0x55, 0x00,    0x00, 0x00, 0x00, 0x00,   0x29, 0x41, 0x76, 0x71, // 0x2*
//    0x00, 0x23, 0x08, 0xdf,   0x2d, 0x03, 0x80, 0x00,    0x55, 0x55, 0x55, 0x00,   0x21, 0x00, 0x00, 0x00, // 0x3*
//    0x00, 0x29, 0x10, 0xc0,   0x00, 0x00, 0x00, 0x00,    0x00, 0x00, 0x01, 0x02,   0x07, 0x10, 0x20, 0x37, // 0x4*
//    0x50, 0x66, 0x76, 0x7e,   0x21, 0x74, 0xca, 0xfe,    0x80, 0x50, 0x40, 0x00,   0x40, 0x02, 0x11, 0x28, // 0x5*
//    0x3e, 0x0b, 0x55, 0x15,   0x11, 0x00, 0x19, 0x0c,    0x0c, 0x73, 0x0b, 0x16,   0x00, 0xfe, 0xb0, 0x30, // 0x6*
//    0x59, 0x71, 0x20, 0x05,   0x00, 0x00, 0x04, 0xa0,    0x00, 0x49, 0x28, 0x42,   0x16, 0xf2, 0x90, 0x97, // 0x7*
//    0xfc, 0xe4, 0x47, 0x7f,   0x0e, 0x21, 0x35, 0xc1,    0x4c, 0x94, 0xad, 0x26,   0x01, 0x22, 0x51, 0x01, // 0x8*
//    0x00, 0x00, 0x00, 0x73,   0x66, 0x38, 0x77, 0x74,    0x8a, 0x77, 0x66, 0x9f,   0x95, 0x06, 0x8a, 0x67, // 0x9*
//    0x17, 0x00, 0x00, 0xa5,   0x00, 0x00, 0x08, 0x46,    0x46, 0x1f, 0xd8, 0x02,   0x64, 0x00, 0x11, 0x24, // 0xa*
//    0x1b, 0x80, 0x00, 0x00,   0x80, 0x15, 0x84, 0xc3,    0x05, 0x80, 0xf0, 0x03,   0xd0, 0xf1, 0xc3, 0x00, // 0xb*
//    0x00, 0x00, 0xc0, 0x00,   0x00, 0x89, 0x33, 0x00,    0x00, 0x3c, 0x2f, 0xae,   0x80, 0x04, 0x01, 0x38, // 0xc*
//    0x00, 0x00, 0x01, 0x03,   0xa5, 0x14, 0x00, 0x00,    0x00, 0x25, 0x0e, 0x30 
//};

//低频带外 2.360G  1M 
//0x1F   ---> 0x80  whiten

static  const uint8_t CSEM_RF_TBL_1MBPS[CSEM_RF_INIT_TBL_1MBPS_SIZE] =
{
    0x22, 0x00, 0x00, 0x80,   0x00, 0x22, 0x0b, 0x14,    0x10, 0x20, 0x00, 0x00,   0x00, 0x03, 0x00, 0xff, // 0x0*
    0xff, 0x0f, 0x00, 0x00,   0x80, 0x23, 0x82, 0x00,    0xC7, 0x71, 0x0C, 0x82,   0x00, 0x01, 0x01, 0x80, // 0x1*
    0x39, 0x8E, 0x83, 0x82,   0xff, 0x00, 0x55, 0x00,    0x00, 0x00, 0x00, 0x00,   0x29, 0x41, 0x76, 0x71, // 0x2*
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    0x00, 0x00, 0x01, 0x03,   0xa5, 0x14, 0x00, 0x00,    0x00, 0x25, 0x0e, 0x30 
};

static  const uint8_t CSEM_RF_TBL_1MBPS_HIGH[CSEM_RF_INIT_TBL_1MBPS_SIZE] =
{
//    0x22, 0x00, 0x00, 0x80,   0x00, 0x22, 0x0b, 0x14,    0x10, 0x20, 0x00, 0x00,   0x00, 0x03, 0x00, 0xff, // 0x0*
//    0xff, 0x0f, 0x00, 0x00,   0x80, 0x23, 0x82, 0x00,    0x00, 0x00, 0x28, 0x82,   0x00, 0x01, 0x01, 0x80, // 0x1*
//    0x39, 0x8E, 0x83, 0x82,   0xff, 0x00, 0x55, 0x00,    0x00, 0x00, 0x00, 0x00,   0x29, 0x41, 0x76, 0x71, // 0x2*
//    0x00, 0x23, 0x08, 0xdf,   0x2d, 0x03, 0x80, 0x00,    0x55, 0x55, 0x55, 0x00,   0x21, 0x00, 0x00, 0x00, // 0x3*
//    0x00, 0x29, 0x10, 0xc0,   0x00, 0x00, 0x00, 0x00,    0x00, 0x00, 0x01, 0x02,   0x07, 0x10, 0x20, 0x37, // 0x4*
//    0x50, 0x66, 0x76, 0x7e,   0x21, 0x74, 0xca, 0xfe,    0x80, 0x50, 0x40, 0x00,   0x40, 0x02, 0x11, 0x28, // 0x5*
//    0x3e, 0x0b, 0x55, 0x15,   0x11, 0x00, 0x19, 0x0c,    0x0c, 0x73, 0x0b, 0x16,   0x00, 0xfe, 0xb0, 0x30, // 0x6*
//    0x59, 0x71, 0x20, 0x05,   0x00, 0x00, 0x04, 0xa0,    0x00, 0x49, 0x28, 0x42,   0x16, 0xf2, 0x90, 0x97, // 0x7*
//    0xfc, 0xe4, 0x47, 0x7f,   0x0e, 0x21, 0x35, 0xc1,    0x4c, 0x94, 0xad, 0x26,   0x01, 0x22, 0x51, 0x01, // 0x8*
//    0x00, 0x00, 0x00, 0x73,   0x66, 0x38, 0x77, 0x74,    0x8a, 0x77, 0x66, 0x9f,   0x95, 0x06, 0x8a, 0x67, // 0x9*
//    0x17, 0x00, 0x00, 0xa5,   0x00, 0x00, 0x08, 0x46,    0x46, 0x1f, 0xd8, 0x02,   0x64, 0x00, 0x11, 0x24, // 0xa*
//    0x1b, 0x80, 0x00, 0x00,   0x80, 0x15, 0x84, 0xc3,    0x05, 0x80, 0xf0, 0x03,   0xd0, 0xf1, 0xc3, 0x00, // 0xb*
//    0x00, 0x00, 0xc0, 0x00,   0x00, 0x89, 0x33, 0x00,    0x00, 0x3c, 0x2f, 0xae,   0x80, 0x04, 0x01, 0x38, // 0xc*
//    0x00, 0x00, 0x01, 0x03,   0xa5, 0x14, 0x00, 0x00,    0x00, 0x25, 0x0e, 0x30 
	
	  0x22, 0x00, 0x00, 0x80,   0x00, 0x22, 0x0b, 0x14,    0x10, 0x20, 0x00, 0x00,   0x00, 0x03, 0x00, 0xff, // 0x0*
    0xff, 0x0f, 0x00, 0x00,   0x80, 0x23, 0x82, 0x00,    0x55, 0x55, 0x27, 0x82,   0x00, 0x01, 0x01, 0x80, // 0x1*
    0x39, 0x8E, 0x83, 0x82,   0xff, 0x00, 0x55, 0x00,    0x00, 0x00, 0x00, 0x00,   0x29, 0x41, 0x76, 0x71, // 0x2*
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    0x00, 0x00, 0x01, 0x03,   0xa5, 0x14, 0x00, 0x00,    0x00, 0x25, 0x0e, 0x30 
};

static  const uint8_t CSEM_RF_TBL_1MBPS_BLUE[CSEM_RF_INIT_TBL_1MBPS_SIZE] =
{
	  0x22, 0x00, 0x00, 0x80,   0x00, 0x22, 0x0b, 0x14,    0x10, 0x20, 0x00, 0x00,   0x00, 0x03, 0x00, 0xff, // 0x0*
    0xff, 0x0f, 0x00, 0x00,   0x80, 0x23, 0x82, 0x00,    0x1b, 0xc7, 0x15, 0x82,   0x00, 0x01, 0x01, 0x80, // 0x1*
    0x72, 0x1c, 0x87, 0x82,   0xff, 0x00, 0x55, 0x00,    0x00, 0x00, 0x00, 0x00,   0x29, 0x41, 0x76, 0x71, // 0x2*
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    0x00, 0x00, 0x01, 0x03,   0xa5, 0x14, 0x00, 0x00,    0x00, 0x25, 0x0e, 0x30 
};



void app_csem_set_receive_mode(void);
unsigned char app_iris_get_reverse(unsigned char ch);
/*
初始化和建立一个任务来处理中断发送过来的消息
*/
int app_iris_calculate_init(unsigned int frequency)
{
			unsigned char i;
	
	    p_csem_tx_callback = NULL;
	    p_csem_rx_callback = NULL;
	
			app_csem_idle_mode();

			cobra_ceva_baseband_csem_register_write(0x017,0x00);
	
      if((frequency >= 2360) && (frequency <= 2401))   //带外 低 
		  {
			    for(i = 0; i < CSEM_RF_INIT_TBL_1MBPS_SIZE; i++)
			    {
					   cobra_ceva_baseband_csem_register_write(i, CSEM_RF_TBL_1MBPS[i]);
			    }		
	    }
		  else if((frequency >= 2481) && (frequency <= 2511))    //带外  高 
		  {
			  	for(i = 0; i < CSEM_RF_INIT_TBL_1MBPS_SIZE; i++)
			    {
					   cobra_ceva_baseband_csem_register_write(i, CSEM_RF_TBL_1MBPS_HIGH[i]);
			    }		
		  }
			else if((frequency >= 2402) && (frequency <= 2480))   //带内 
			{
				  for(i = 0; i < CSEM_RF_INIT_TBL_1MBPS_SIZE; i++)
			    {
					   cobra_ceva_baseband_csem_register_write(i, CSEM_RF_TBL_1MBPS_BLUE[i]);
			    }		
				
			}
		 
			return 0;	
}

/*
使能各种发送接受中断

*/
void app_csem_irq_enable(CSEM_IRQ_TYPE irq)
{
			unsigned char value;
			unsigned char temp;
			switch(irq)
			{
				case CSEM_IRQ_TX_FLAG:
					value = 0x01;
					break;
				case CSEM_IRQ_RXSTOP_FLAG:
					value = 0x02;
					break;
				case CSEM_IRQ_RECEIVED_FLAG:
					value = 0x04;
					break;
				case CSEM_IRQ_SYNC_FLAG:
					value = 0x08;
					break;
				case CSEM_IRQ_TXFIFO_FLAG:
					value = 0x10;
					break;
				case CSEM_IRQ_RXFIFO_FLAG:
					value = 0x20;
					break;
				default:
					value = 0x00;
					break;
				
			}
			temp = cobra_ceva_baseband_csem_register_read(CS565_REG_IRQ_CONF);
			temp |= value&0x3f;
		  cobra_ceva_baseband_csem_register_write(CS565_REG_IRQ_CONF, temp);
}

unsigned char app_csem_read_rx_fifo(void)
{
		unsigned char temp;
		temp = cobra_ceva_baseband_csem_register_read(CS565_REG_RXFIFO);
		return temp;
}

unsigned char app_csem_read_deser_status(void)
{
		volatile unsigned char temp;
		temp = cobra_ceva_baseband_csem_register_read(CS565_REG_DESER_STATUS);
		return temp;
	
}

unsigned char app_csem_read_fsm_status(void)
{
		volatile unsigned char temp;
		temp = cobra_ceva_baseband_csem_register_read(CS565_REG_FSM_STATUS);
		return temp;
	
}

void app_csem_flush_rx_fifo(void)
{
		cobra_ceva_baseband_csem_register_write(CS565_REG_RXFIFO_STATUS, 0x01);
}


void app_csem_flush_tx_fifo(void)
{
		cobra_ceva_baseband_csem_register_write(CS565_REG_TXFIFO_STATUS, 0x01);
}


void app_csem_set_sync_word(unsigned int sync)
{
			cobra_ceva_baseband_csem_register_write(CS565_REG_PATTERN, sync&0xff);
			cobra_ceva_baseband_csem_register_write(CS565_REG_PATTERN+1, (sync>>8)&0xff);
			cobra_ceva_baseband_csem_register_write(CS565_REG_PATTERN+2, (sync>>16)&0xff);
			cobra_ceva_baseband_csem_register_write(CS565_REG_PATTERN+3, (sync>>24)&0xff);	
}

unsigned char app_csem_read_irq_status(void)
{
		volatile unsigned char temp;
		temp = cobra_ceva_baseband_csem_register_read(CS565_REG_IRQ_STATUS);
		return temp;
}



void app_csem_idle_mode(void)
{
		cobra_ceva_baseband_csem_register_write(CS565_REG_FSM_MODE, 0x08);
}



void cobra_csem_irq_tx_interrupt(void)
{

		cobra_ceva_baseband_csem_register_read(CS565_REG_IRQ_STATUS);
	
	  if(p_csem_tx_callback != NULL)
	  {
		   p_csem_tx_callback();
	  }
		
}

void cobra_csem_irq_sync_interrupt(void)
{
	cobra_ceva_baseband_csem_register_read(CS565_REG_IRQ_STATUS);	
	printf("sync\n");
}

void cobra_csem_irq_received_interupt(void)
{
	
	  cobra_ceva_baseband_csem_register_read(CS565_REG_IRQ_STATUS);
	
	  if(p_csem_rx_callback != NULL)
	  {
		   p_csem_rx_callback();
	  }

}


void app_csem_pluse_calculate_init(void)
{
	  cobra_ceva_baseband_csem_register_write(CS565_REG_PACKET_HANDLING, 0xf3); //en_packet, en_pattern, en_preamble
	  cobra_ceva_baseband_csem_register_write(CS565_REG_PACKET_LENGTH_OPTS, 0x01); //en_address = 0 , packet_len_pos = 1	
	  cobra_ceva_baseband_csem_register_write(CS565_REG_CODING, 0x80);      //0x80 enable
	  NVIC_ClearPendingIRQ(CSEM_IRQ_RXSTOP);
		NVIC_ClearPendingIRQ(CSEM_IRQ_RECEIVED);
		NVIC_ClearPendingIRQ(CSEM_IRQ_SYNC);
		NVIC_ClearPendingIRQ(CSEM_IRQ_TX);
}


/*
开始接受数据	
*/
void app_csem_receive_go(void)
{
		app_csem_idle_mode();
		app_csem_irq_enable(CSEM_IRQ_RECEIVED_FLAG);
//	  app_csem_irq_enable(CSEM_IRQ_SYNC_FLAG);
//		cobra_ceva_baseband_csem_register_write(CS565_REG_FSM_MODE, 0x03);
}

void app_csem_set_receive_mode(void)
{
	  cobra_ceva_baseband_csem_register_write(CS565_REG_FSM_MODE, 0x03);
}


void app_csem_set_tx_callback(csem_tx_callback_t func)
{
	  p_csem_tx_callback = func;
	
}
void app_csem_set_rx_callback(csem_rx_callback_t func)
{
	  p_csem_rx_callback = func;
}

unsigned char app_iris_get_reverse(unsigned char ch)
{
	 return BitReverseTable256[ch];
}

/*
设置通讯频率
*/
unsigned int app_iris_set_frequency(unsigned short frequency)
{

	      unsigned char old_range;
	      unsigned char new_range;
        unsigned char ch;
	
//	      if(old_frequency == frequency) return 0;
#if 1		
	      if(old_frequency <= 2401)
		    {
			       old_range = 0;
		    }
		    else if(old_frequency <= 2480)
		    {
			      old_range = 1;
		    }
		    else
		    {
			      old_range = 2;
		    }
				
				if(frequency <= 2401)
		    {
			     new_range = 0;
		    }
		    else if(frequency <= 2480)
		    {
			     new_range = 1;
		    }
		    else
		    {
			     new_range = 2;
		    }			

		   if((new_range != old_range) || (old_frequency == 0))
		   {
			      old_frequency = frequency;
				    if(new_range == 0)   //带外低频
						{ 
							    cobra_ceva_baseband_csem_register_write_word(CS565_REG_CENTER_FREQ, 0x820c71c7);  //中心频率
							    cobra_ceva_baseband_csem_register_write_half_word(CS565_REG_CHANNELS_1, 0x8e39);  //步宽
							    cobra_ceva_baseband_csem_register_write(CS565_REG_CHANNELS_2, 0x83);
						}	  
						else if(new_range == 1)  //蓝牙带内
						{   
							    cobra_ceva_baseband_csem_register_write_word(CS565_REG_CENTER_FREQ, 0x8215c71b);  //中心频率
							    cobra_ceva_baseband_csem_register_write_half_word(CS565_REG_CHANNELS_1, 0x1C72);  //步宽
							    cobra_ceva_baseband_csem_register_write(CS565_REG_CHANNELS_2, 0x87);
						}
						else              //带外高频
						{
							  cobra_ceva_baseband_csem_register_write_word(CS565_REG_CENTER_FREQ, 0x82275555);  //中心频率
							  cobra_ceva_baseband_csem_register_write_half_word(CS565_REG_CHANNELS_1, 0x8e39);  //步宽
							  cobra_ceva_baseband_csem_register_write(CS565_REG_CHANNELS_2, 0x83);
						} 
		   }
#endif		 
	     if((frequency >= 2360) && (frequency <= 2401))
		   {
			    ch = frequency - 2360;
		      cobra_ceva_baseband_csem_register_write(CS565_REG_CHANNEL, ch&0x3f);  
	     }
		   else if((frequency >= 2481) && (frequency <= 2511))
		   {
			     ch = frequency - 2481;
		       cobra_ceva_baseband_csem_register_write(CS565_REG_CHANNEL, ch&0x3f); 
		   }
			 else if((frequency >= 2402) && (frequency <= 2480))
			 {
				   ch = frequency - 2402;
				   ch >>= 1;
				   cobra_ceva_baseband_csem_register_write(CS565_REG_CHANNEL, ch&0x3f); 
			 }
		 
			 return 1;
}
/*
 设置接入地址
*/
void app_iris_set_access_address(unsigned int address)
{
    app_csem_set_sync_word(address);
}

/*
 设置白噪化初始值
 这个是根据频率来设定的
*/
static const unsigned char low_whitelist_init_table[42] = {
	37,  37,  0,   0,   1,  1,   2,  2,  3,  3,  4,  4,  5,  5,  6,  6,  7,  7,  8,  8,  
	9,   9,   10,  10,  38, 38,  11, 11, 12, 12, 13, 13, 14, 14, 15, 15, 16, 16, 17, 17,	18, 18,
};

static const unsigned char high_whitelist_init_table[28] = {
	37, 37, 0,  0,  1,  1,  2,  2,  3,  3,  4,  4,  5, 5,  6, 6, 7, 7, 8, 8,
	9,  9,  10, 10, 38, 38, 11, 11,
};

static const unsigned char blue_whitelist_init_table[40] = {
	37, 0,  1,  2,  3,  4,  5,  6,  7,  8,  9,  10, 38, 11, 12, 13, 14, 15, 16, 17, 
	18, 19, 20, 21, 22, 23, 24, 25, 26, 27, 28, 29, 30, 31, 32, 33, 34, 35, 36, 39,
};

void app_iris_set_whitelist_value(unsigned short frequency)
{
	     unsigned char ch;
	     unsigned char white_list_value;
	
	//     if(old_frequency == frequency) return ;
	
	     if((frequency >= 2360) && (frequency <= 2401))
		   {
			    ch = frequency - 2360; 
				  white_list_value = low_whitelist_init_table[ch];
	     }
		   else if((frequency >= 2484) && (frequency <= 2511))
		   {
			     ch = frequency - 2484;
				   white_list_value = high_whitelist_init_table[ch];
		   }
			 else if((frequency >= 2402) && (frequency <= 2480))
			 {
				   ch = frequency - 2402;
				   ch >>= 1;
				   white_list_value = blue_whitelist_init_table[ch];
			 }
			 else if(frequency == 2481)
			 {
				  white_list_value = 18;			 
			 }
			 else if((frequency == 2482) || (frequency == 2483) )
			 {
				  white_list_value = 19;	
			 }
	     cobra_ceva_baseband_csem_register_write(CS565_REG_DATAWHITE_BTLE, 0x80 + (app_iris_get_reverse(white_list_value + 0x40) >> 1)); //app_iris_get_reverse(37));  //Disable whiten  0xc0
	  
}
#endif



